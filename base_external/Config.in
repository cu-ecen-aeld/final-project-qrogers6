## base_external/Config.in
```kconfig
source "$BR2_EXTERNAL_assignment_base_PATH/package/polygon-api-client/Config.in"
source "$BR2_EXTERNAL_assignment_base_PATH/package/final-assignment/Config.in"
```

## base_external/package/final-assignment/Config.in
```kconfig
config BR2_PACKAGE_FINAL_ASSIGNMENT
	bool "final-assignment"
	help
	  Includes the stock portfolio generator python script
```

## base_external/package/polygon-api-client/Config.in
```kconfig
config BR2_PACKAGE_POLYGON_API_CLIENT
	bool "polygon-api-client"
	help
	  The Polygon.io Stocks API provides REST endpoints that let you query the 
	  latest market data from all US stock exchanges. You can also find data on 
	  company financials, stock market holidays, corporate actions, and more.
```
